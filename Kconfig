## Kconfig
```kconfig
mainmenu "SC-OBC Module A1 Bootloader"

menu "Bootloader"

config SCOBC_A1_BOOT_CFG_COPY_SIZE_KB
	int "The size (in Kbytes) that the bootloader copies from config memory to HRMEM"
	default 1024
	help
	  The size (in Kbytes) that the bootloader copies from config memory to HRMEM.

endmenu

menu "Zephyr"
source "Kconfig.zephyr"
endmenu
```

## west.yml
```yaml
manifest:

  projects:
    - name: zephyr
      url: https://github.com/zephyrproject-rtos/zephyr.git
      revision: main
      path: zephyr
      west-commands: scripts/west-commands.yml
      import:
        name-allowlist:
          - cmsis
          - cmsis_6
```
